## arch/riscv32/soc/litex-vexriscv/Kconfig.defconfig
```kconfig
if SOC_RISCV32_LITEX_VEXRISCV

config SOC
	string
	default "litex-vexriscv"

config SYS_CLOCK_HW_CYCLES_PER_SEC
	int
	default 100000000

config RISCV_SOC_INTERRUPT_INIT
	bool
	default n

config RISCV_HAS_CPU_IDLE
	bool
	default n

config RISCV_HAS_PLIC
	bool
	default n

config NUM_IRQS
	int
	default 12

config XIP
	bool
	default y

config RISCV_ROM_BASE_ADDR
	hex
	default 0x40000000

config RISCV_ROM_SIZE
	hex
	default 0x8000

config RISCV_RAM_BASE_ADDR
	hex
	default	0x40008000

config RISCV_RAM_SIZE
	hex
	default 0xFFF8000

config SERIAL_SUPPORT_INTERRUPT
    bool
    default y

endif # SOC_RISCV32_LITEX_VEXRISCV
```

## boards/riscv32/arty_litex_vexriscv/Kconfig.board
```kconfig
config BOARD_ARTY_LITEX_VEXRISCV
	bool "Digilent Arty dev board with LiteX/VexRiscv CPU"
    select HAS_DTS
	depends on SOC_RISCV32_LITEX_VEXRISCV
```

## boards/riscv32/arty_litex_vexriscv/Kconfig.defconfig
```kconfig
if BOARD_ARTY_LITEX_VEXRISCV

config BOARD
	default "arty_litex_vexriscv"

endif
```

## boards/riscv32/arty_litex_vexriscv/arty_litex_vexriscv_defconfig
```kconfig
CONFIG_RISCV32=y
CONFIG_SOC_RISCV32_LITEX_VEXRISCV=y
CONFIG_BOARD_ARTY_LITEX_VEXRISCV=y
CONFIG_VEXRISCV_LITEX_IRQ=y
CONFIG_LITEX_TIMER=y
CONFIG_CONSOLE=y
CONFIG_SERIAL=y
CONFIG_UART_LITEUART=y
CONFIG_UART_LITEUART_PORT_0=y
CONFIG_UART_CONSOLE=y
CONFIG_UART_INTERRUPT_DRIVEN=y
```

## boards/riscv32/litex_picorv32/Kconfig.board
```kconfig
config BOARD_LITEX_PICORV32
	bool "Dev board with PicoRV32 CPU"
	select HAS_DTS
	depends on SOC_RISCV32_LITEX_PICORV32
```

## boards/riscv32/litex_picorv32/litex_picorv32_defconfig
```kconfig
CONFIG_RISCV32=y
CONFIG_SOC_RISCV32_LITEX_PICORV32=y
CONFIG_BOARD_LITEX_PICORV32=y
CONFIG_PICORV32_LITEX_IRQ=y
CONFIG_LITEX_TIMER=y
CONFIG_CONSOLE=y
CONFIG_SERIAL=y
CONFIG_UART_LITEUART=y
CONFIG_UART_LITEUART_PORT_0=y
CONFIG_UART_CONSOLE=y
CONFIG_UART_INTERRUPT_DRIVEN=y
```

## drivers/ethernet/Kconfig.liteeth
```kconfig
menuconfig ETH_LITEETH
    bool "LiteEth Ethernet core driver"
	depends on NET_L2_ETHERNET

if ETH_LITEETH

config ETH_LITEETH_0
    bool "LiteEth Ethernet port 0"
    help
        Include port 0 driver

config ETH_LITEETH_0_IRQ_PRI
    int "LiteEth interrupt priority"
    depends on ETH_LITEETH_0
    default 0
    help
        IRQ priority

choice ETH_LITEETH_0_MAC_SELECT
    prompt "MAC address"
    help
        Choose how to configure MAC address

config ETH_LITEETH_0_MAC_MANUAL
    bool "Manual MAC address"

endchoice # ETH_LITEETH_0_MAC_SELECT

if ETH_LITEETH_0_MAC_MANUAL

config ETH_LITEETH_0_MAC_1
    hex "MAC address byte 1"
    default 0x10
    range 0x00 0xff

config ETH_LITEETH_0_MAC_2
    hex "MAC address byte 2"
    default 0xe2
    range 0x00 0xff

config ETH_LITEETH_0_MAC_3
    hex "MAC address byte 3"
    default 0xd5
    range 0x00 0xff

config ETH_LITEETH_0_MAC_4
    hex "MAC address byte 4"
    default 0x00
    range 0x00 0xff

config ETH_LITEETH_0_MAC_5
    hex "MAC address byte 5"
    default 0x00
    range 0x00 0xff

config ETH_LITEETH_0_MAC_6
    hex "MAC address byte 6"
    default 0x00
    range 0x00 0xff

endif # ETH_LITEETH_0_MAC_MANUAL

endif # ETH_LITEETH
```

## drivers/serial/Kconfig.litex
```kconfig
# Kconfig.litex - LiteX UART (LiteUART) configuration option
#
# Copyright (c) 2018 Antmicro <www.antmicro.com>
#

menuconfig UART_LITEUART
	bool "LiteUART serial driver"
	depends on SOC_RISCV32_LITEX_VEXRISCV
	select SERIAL_HAS_DRIVER
	help
	  This option enables LiteUART serial driver.

menuconfig UART_LITEUART_PORT_0
	bool "Enable LiteX Port 0"
	depends on UART_LITEUART
	help
	  This tells the driver to configure the UART port at boot, depending on
	  the additional configuration options below.

config UART_LITEUART_PORT_0_IRQ_PRIORITY
	int "Port 0 Interrupt Priority"
	default 1
	depends on UART_LITEUART_PORT_0
	help
	  Port 0 Interrupt Priority
```

## dts/bindings/ethernet/litex,eth0.yaml
```yaml
#
# Copyright (c) 2019 Antmicro <www.antmicro.com>
#
# SPDX-License-Identifier: Apache-2.0
#
---
title: LiteX Ethernet
version: 0.1

description: >
    This binding gives a base representation of LiteX Ethernet

properties:
    compatible:
        type: string
        category: required
        description: compatible strings
        constraint: "litex,eth0"

    label:
        type: string
        category: required
        description: human readable interface name
        generation: define

    reg:
        type: array
        description: mmio register space
        generation: define
        category: required

    interrupts:
        type: array
        category: required
        description: required interrupts
        generation: define
...
```

## dts/bindings/interrupt-controller/picorv32,intc0.yaml
```yaml
#
# Copyright (c) 2018 Antmicro <www.antmicro.com>
#
# SPDX-License-Identifier: Apache-2.0
#
---
title: LiteX PicoRV32 Interrupt Controller
version: 0.1

description: >
    This binding describes LiteX PicoRV32 Interrupt Controller
properties:
  compatible:
      category: required
      type: string
      description: compatible strings
      constraint: "picorv32,intc0"
      generation: define

  reg:
      category: required
      type: int
      description: mmio register space
      generation: define

  riscv,max-priority:
      type: int
      description: maximum interrupt priority
      category: required
      generation: define

"#cells":
  - irq
...
```

## dts/bindings/interrupt-controller/vexriscv,intc0.yaml
```yaml
#
# Copyright (c) 2018 Antmicro <www.antmicro.com>
#
# SPDX-License-Identifier: Apache-2.0
#
---
title: LiteX VexRiscv Interrupt Controller
id: vexriscv,intc0
version: 0.1

description: >
    This binding describes Litex Vexriscv Interrupt Controller

properties:
  compatible:
      category: required
      type: string
      description: compatible strings
      constraint: "vexriscv,intc0"
      generation: define

  reg:
      category: required
      type: int
      description: mmio register space
      generation: define

  riscv,max-priority:
      type: int
      description: maximum interrupt priority
      category: required
      generation: define

"#cells":
  - irq
...
```

## dts/bindings/serial/litex,uart0.yaml
```yaml
#
# Copyright (c) 2018 Antmicro <www.antmicro.com>
#
# SPDX-License-Identifier: Apache-2.0
#
---
title: LiteX UART
id: litex,uart0
version: 0.1

description: >
    This binding gives a base representation of the LiteX UART

inherits:
    !include uart.yaml

properties:
    compatible:
      type: string
      category: required
      description: compatible strings
      constraint: "litex,uart0"
      generation: define

    reg:
      type: array
      description: mmio register space
      generation: define
      category: required

    interrupts:
      type: array
      category: required
      description: required interrupts
      generation: define

...
```

## dts/bindings/timer/litex,timer0.yaml
```yaml
---
title: Litex timer
id: litex,timer
version: 0.1

description: >
    This binding gives a base representation of LiteX timer

properties:
    compatible:
      type: string
      category: required
      description: compatible strings
      constraint: "litex,timer0"

    reg:
      type: array
      description: mmio register space
      generation: define
      category: required

    interrupts:
      type: array
      category: required
      description: required interrupts
      generation: define
...
```

## samples/net/civetweb/sample.yaml
```yaml
sample:
  description: HTTP port
  name: http_port
tests:
  test:
    filter: TOOLCHAIN_HAS_NEWLIB == 1
    harness: net
    min_ram: 32
    min_flash: 128
    tags: net socket
```

## samples/net/gptp/sample.yaml
```yaml
common:
  harness: net
  tags: net gptp
sample:
  description: Test gPTP functionality
  name: gPTP sample app
tests:
  test:
    platform_whitelist: qemu_x86 frdm_k64f
    depends_on: netif
    # To avoid "Too many thread objects" error
    extra_configs:
      - CONFIG_USERSPACE=n
```

## soc/riscv32/litex-picorv32/Kconfig.soc
```kconfig
config SOC_RISCV32_LITEX_PICORV32
	bool "LiteX PicoRV32 system implementation"
	select ATOMIC_OPERATIONS_C

config UART_CONSOLE_ON_DEV_NAME
	string
	default "uart0"
	depends on SOC_RISCV32_LITEX_PICORV32
```

## soc/riscv32/litex-vexriscv/Kconfig.defconfig
```kconfig
if SOC_RISCV32_LITEX_VEXRISCV

config SOC
	string
	default "litex-vexriscv"

config SYS_CLOCK_HW_CYCLES_PER_SEC
	int
	default 100000000

config RISCV_SOC_INTERRUPT_INIT
	bool
	default n

config RISCV_HAS_CPU_IDLE
	bool
	default n

config RISCV_HAS_PLIC
	bool
	default n

config NUM_IRQS
	int
	default 12

config XIP
	bool
	default y

config RISCV_RAM_BASE_ADDR
	hex
	default	0x40000000

config RISCV_RAM_SIZE
	hex
	default 0x10000000

config SERIAL_SUPPORT_INTERRUPT
    bool
    default y

endif # SOC_RISCV32_LITEX_VEXRISCV
```

## soc/riscv32/litex-vexriscv/Kconfig.soc
```kconfig
config SOC_RISCV32_LITEX_VEXRISCV
	bool "LiteX VexRiscv system implementation"
	select ATOMIC_OPERATIONS_C
```
